## CMakeLists.txt
```
cmake_minimum_required(VERSION 3.20.0)
# A connectable GATT peripheral on our open link layer: one primary service
# with a readable and writable characteristic, for host GATT clients (bleak,
# bluetoothctl) driving it over the simulated RF medium.  UNVALIDATED ON
# HARDWARE.  Build from the repository root:
#   nix develop . -c cmake -G Ninja -S tests/gatt-peripheral-port -B build/gatt-peripheral-port-qemu \
#     -DBOARD=bg22_ek4108a -DZEPHYR_BASE="$PWD/vendor/zephyr" \
#     -DZephyr_DIR="$PWD/vendor/zephyr/share/zephyr-package/cmake" \
#     -DZEPHYR_MODULES="$PWD/vendor/cmsis_6;$PWD/vendor/hal_silabs;$PWD/vendor/mbedtls;$PWD/vendor/tf-psa-crypto"
#   nix develop . -c cmake --build build/gatt-peripheral-port-qemu
list(APPEND ZEPHYR_EXTRA_MODULES ${CMAKE_CURRENT_LIST_DIR}/../../modules/efr32-radio)
find_package(Zephyr REQUIRED HINTS $ENV{ZEPHYR_BASE})
project(efr32_gatt_peripheral_port)
target_sources(app PRIVATE src/main.c)
```

## Kconfig
```
# SPDX-License-Identifier: Apache-2.0
# Module defaults that must precede Zephyr's own (modules/efr32-radio/Kconfig.defaults).
osource "$(ZEPHYR_EFR32_RADIO_MODULE_DIR)/Kconfig.defaults"
source "Kconfig.zephyr"
```

## prj.conf
```kconfig
CONFIG_BT=y
CONFIG_BT_PERIPHERAL=y
CONFIG_BT_DEVICE_NAME="efr32-gatt"
CONFIG_BT_MAX_CONN=1

# The lower link layer, as tests/radio-port/prj.conf and prj-connection.conf
# configure it for QEMU.
CONFIG_EFR32_RADIO_STUB_REGISTERS=n
# The silicon path: no QEMU-only seam (the sequencer turns around at T_IFS); with the seams the
# link failed to establish (0x3e) in the vhci GATT test.
CONFIG_EFR32_RADIO_QEMU_TIFS=n
CONFIG_EFR32_RADIO_QEMU_RX_DESCRIPTOR=n
CONFIG_ENTROPY_GENERATOR=y
CONFIG_CLOCK_EVENT_SYSTEM_TIMER=y
CONFIG_SILABS_BURTC_CLOCK_EVENT=y
CONFIG_COUNTER_SILABS_BURTC=n
CONFIG_COUNTER=y
CONFIG_COUNTER_SILABS_TIMER_CLOCK_EVENT=y
CONFIG_COUNTER_GECKO_STIMER=n
CONFIG_NUM_METAIRQ_PRIORITIES=2
CONFIG_EFR32_RADIO_TIMING_QEMU=y
CONFIG_BT_CTLR_ADVANCED_FEATURES=y
CONFIG_BT_CTLR_ZLI=n
CONFIG_ISR_STACK_SIZE=1024
CONFIG_MAIN_STACK_SIZE=1536
CONFIG_EFR32_RADIO_ULL_STACK_SIZE=896
CONFIG_EFR32_RADIO_LAUNCH_STACK_SIZE=640
CONFIG_EFR32_RADIO_COMPLETION_STACK_SIZE=960
# Connection-event launch deadlines are unreachable at QEMU instruction
# pacing (tests/radio-rx-port/prj-central.conf): count misses instead of a
# safe shutdown, in this QEMU profile only.
CONFIG_SCHED_DEADLINE_MISS_COUNT=y
# lll_conn_force_md_cnt_set() is the Nordic LLL's; the EFR32 LLL has no forced-MD hook.
CONFIG_BT_CTLR_FORCE_MD_AUTO=n

CONFIG_LOG=y
CONFIG_LOG_BUFFER_SIZE=256
# Database hashing (multi-part AES-CMAC through PSA Crypto, on RADIOAES) works
# with -DCONFIG_PSA_CRYPTO=y (docs/crypto.md), but PSA Crypto costs RAM here.
CONFIG_BT_GATT_CACHING=n
```

## src/main.c
```c
/*
 * Connectable GATT peripheral: one primary service with one characteristic
 * that a client can read, write and write without response.  Every write is
 * echoed on the console so a host-side test can check it arrived.
 *
 * SPDX-License-Identifier: Apache-2.0
 */
#include <string.h>

#include <zephyr/bluetooth/bluetooth.h>
#include <zephyr/bluetooth/conn.h>
#include <zephyr/bluetooth/gatt.h>
#include <zephyr/bluetooth/uuid.h>
#include <zephyr/sys/printk.h>

/* Random 128-bit UUIDs; the service's is the characteristic's with the
 * first group incremented. */
#define TEST_SERVICE_UUID_VAL                                                                      \
	BT_UUID_128_ENCODE(0x8f1c0001U, 0x6d41U, 0x4b3aU, 0x9b6eU, 0x0c2f9a4d7e10ULL)
#define TEST_VALUE_UUID_VAL                                                                        \
	BT_UUID_128_ENCODE(0x8f1c0002U, 0x6d41U, 0x4b3aU, 0x9b6eU, 0x0c2f9a4d7e10ULL)

static const struct bt_uuid_128 test_service_uuid = BT_UUID_INIT_128(TEST_SERVICE_UUID_VAL);
static const struct bt_uuid_128 test_value_uuid = BT_UUID_INIT_128(TEST_VALUE_UUID_VAL);

/* The characteristic's value: the last write, initially a fixed greeting. */
#define TEST_VALUE_MAX_LEN 20U
static uint8_t test_value[TEST_VALUE_MAX_LEN] = "efr32";
static uint16_t test_value_len = sizeof("efr32") - 1U;

static ssize_t read_value(struct bt_conn *conn, const struct bt_gatt_attr *attr, void *buf,
			  uint16_t len, uint16_t offset)
{
	return bt_gatt_attr_read(conn, attr, buf, len, offset, test_value, test_value_len);
}

static ssize_t write_value(struct bt_conn *conn, const struct bt_gatt_attr *attr,
			   const void *buf, uint16_t len, uint16_t offset, uint8_t flags)
{
	if ((offset + len) > sizeof(test_value)) {
		return BT_GATT_ERR(BT_ATT_ERR_INVALID_ATTRIBUTE_LEN);
	}
	memcpy(&test_value[offset], buf, len);
	test_value_len = offset + len;
	printk("gatt_write: %u bytes at %u\n", len, offset);
	return len;
}

BT_GATT_SERVICE_DEFINE(test_service, BT_GATT_PRIMARY_SERVICE(&test_service_uuid),
		       BT_GATT_CHARACTERISTIC(&test_value_uuid.uuid,
					      BT_GATT_CHRC_READ | BT_GATT_CHRC_WRITE |
						      BT_GATT_CHRC_WRITE_WITHOUT_RESP,
					      BT_GATT_PERM_READ | BT_GATT_PERM_WRITE, read_value,
					      write_value, NULL));

static void connected(struct bt_conn *conn, uint8_t err)
{
	printk("connected: 0x%02x\n", err);
}

static void disconnected(struct bt_conn *conn, uint8_t reason)
{
	printk("disconnected: 0x%02x\n", reason);
}

BT_CONN_CB_DEFINE(conn_callbacks) = {
	.connected = connected,
	.disconnected = disconnected,
};

static const struct bt_data ad[] = {
	BT_DATA_BYTES(BT_DATA_FLAGS, (BT_LE_AD_GENERAL | BT_LE_AD_NO_BREDR)),
	BT_DATA_BYTES(BT_DATA_UUID128_ALL, TEST_SERVICE_UUID_VAL),
};

static const struct bt_data sd[] = {
	BT_DATA(BT_DATA_NAME_COMPLETE, CONFIG_BT_DEVICE_NAME, sizeof(CONFIG_BT_DEVICE_NAME) - 1),
};

int main(void)
{
	int err = bt_enable(NULL);

	printk("bt_enable: %d\n", err);
	if (err != 0) {
		return 0;
	}
	err = bt_le_adv_start(BT_LE_ADV_CONN_FAST_2, ad, ARRAY_SIZE(ad), sd, ARRAY_SIZE(sd));
	printk("adv_start: %d\n", err);
	return 0;
}
```
