/*
 * Generated from real, directly-executed MMIO stores: the concatenation of
 * tests/hardware-lockstep/radio-setup-trace-partial.json (159 entries, from
 * radio_phy_set()'s entry) and radio-setup-trace-to-txen.json (41 entries,
 * continuing to the real RAC.CMD.TXEN store), filtered to thread-mode
 * ("exception": 0) stores, EXCLUDING ARM system-control-space addresses
 * (0xE000xxxx: NVIC/SCB) -- those are Zephyr's own scheduler/interrupt
 * bookkeeping (e.g. SCB.ICSR.PENDSVSET), meaningless and unsafe to replay
 * verbatim on this bare-metal image, which has no real scheduler and took
 * a real PendSV into its fault stub the first time this was tried. See
 * docs/radio-tables.md SS7.37-SS7.40.
 * Each pair is (address, value), all captured as real 4-byte stores.
 * Do not hand-edit; regenerate from the trace JSONs if they change.
 */
	{0xb800400cU, 0x00018101U},
	{0xb8004020U, 0x00000000U},
	{0xb8004024U, 0x00000001U},
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	{0xb0003eecU, 0x00000012U},
