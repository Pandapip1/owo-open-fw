## boards/owo/owo_suit/board.yml
```yaml
board:
  name: owo_suit
  full_name: OWO suit control unit (BGM220PC22WGA module)
  socs:
    - name: bgm220pc22wga
```

## boards/owo/owo_suit/dts/bindings/owo,serial-record.yaml
```yaml
# SPDX-License-Identifier: Apache-2.0

description: |
  A unit's serial number in its manufacturing record: twelve ASCII decimal digits at a fixed
  address of memory-mapped, read-only flash. The firmware reads it at run time (src/serial.c)
  and never writes it.

compatible: "owo,serial-record"

properties:
  reg:
    type: array
    required: true
    description: Address and length (12) of the digits.
```

## modules/owo-stim/Kconfig
```kconfig
menuconfig OWO_STIM
	bool "OWO stimulation output stage"
	depends on RUST
	select ADC
	select ADC_ASYNC
	select DAC
	select PWM
	select SPI
	select GPIO
	select REGULATOR
	help
	  Per-part drivers and the safety supervisor for the OWO suit's output stage. Needs an
	  "owo,suit-output" devicetree node for the hardware backend (see dts/bindings/misc).

if OWO_STIM

config DAC_LTC2634
	bool "LTC262x-family DAC (Rust driver)"
	default y
	depends on DT_HAS_LLTC_LTC2634_ENABLED
	select SPI
	select GPIO
	help
	  Zephyr DAC API driver whose logic is the Rust crate "ltc2634".

config DAC_LTC2634_INIT_PRIORITY
	int "LTC2634 init priority"
	default 80
	depends on DAC_LTC2634

config OWO_STIM_UNVALIDATED_HARDWARE
	bool "Drive the real output stage (UNVALIDATED, never run on hardware)"
	depends on DT_HAS_OWO_SUIT_OUTPUT_ENABLED
	help
	  Off: the application only logs what it would stimulate. On: the application drives the
	  output stage through the owo-stim supervisor and requires the hardware watchdog
	  (the application's OWO_WATCHDOG). Read
	  docs/stock-stim-path.md and run the bench checklist in the README first.

config OWO_STIM_HARD_MAX_LEVEL
	int "Hard level ceiling (stock range is 0..126)"
	default 40
	range 1 126

config OWO_STIM_DEADMAN_MS
	int "Dead-man: stop if no frame arrives for this long after the last one ends"
	default 1500

config OWO_STIM_MAX_PHASE_US
	int "Longest allowed phase"
	default 400
	range 1 400
	help
	  Maximum energised duration of either half of a biphasic pulse. The current
	  supervisor performs phase-end and feedback checks in a bounded busy loop;
	  400 us is the safety-reviewed upper bound for that implementation. Do not
	  increase it without replacing the phase loop with a hardware-timed design.

config OWO_STIM_SOFT_START_MS
	int "Soft-start ramp after (re)arming"
	default 500

config OWO_STIM_MAX_DUTY_PERMILLE
	int "Per-channel duty budget (permille of time energised)"
	default 40

config OWO_STIM_WIDTH_SCALE_PERCENT
	int "Pulse width scale vs. the stock table (stock tick suggests 200)"
	default 100
	range 25 200

config OWO_STIM_SENSE_GUARD_US
	int "Longest time from starting a sense conversion to seeing its result"
	default 60
	range 10 200
	help
	  The supervisor starts every feedback conversion itself (owo-stim, interlock 12): the first
	  one of a phase OWO_STIM_SETTLE_US after the bridge closed, later ones only while at least
	  this much of the phase remains, so a conversion's completion interrupt never lands at the
	  end of a phase. A conversion still not done this long after its start is an ADC stall
	  (the output locks). It must cover the driver's start path, the IADC's warm-up and
	  conversion and its completion interrupt. 60 us is a NOMINAL value: in the QEMU model a
	  conversion completes at its start command, and a conversion started 20 us into a 50 us
	  phase has its result before the width ends (phases 53.1 us median, the rest is the
	  bridge-off path; docs/stim-simulation.md); the IADC's warm-up
	  and conversion time on silicon are not modelled. NEEDS A SILICON MEASUREMENT before any
	  hardware use.

config OWO_STIM_SENSE_TIMEOUT_US
	int "A conversion not done this long after its start is an ADC stall"
	default 500
	range 50 5000
	help
	  The output locks on a stall. A phase still ends at its width meanwhile, so this does not
	  lengthen any energised time; it only bounds how long a missing result is waited for, and
	  must exceed the longest latency the ADC's completion interrupt can see, so that an
	  interrupt is never mistaken for a dead ADC. 500 us is the bound the free-running sampler's
	  freshness check used before (OWO_STIM_SENSE_MAX_AGE_US); the longest interrupts measured
	  on silicon are the TIMER0 clock event (39.4 us steady state, 90.6 us at boot) and BURTC
	  (34.2 us) (docs/radio-tables.md 7.76), so even two back to back stay below a third of it.

config OWO_STIM_SETTLE_US
	int "Time after the bridge closes before the first in-phase conversion"
	default 20
	range 1 200
	help
	  The output's rise time after the bridge closes is not measured; until it is, the stock
	  firmware's habit of sampling into the phase is kept with this nominal value. Phases no
	  longer than this are not delivered (they could not be measured). NEEDS A SILICON
	  MEASUREMENT (rise time of the sense signal at the lowest load impedance).

config OWO_STIM_UNDER_MARGIN
	int "Under-delivery: stop when the sense reads more than this below the command"
	default 14
	range 1 126
	help
	  Open electrode, lost contact, a sense stuck at zero or a rail out of compliance: an
	  in-phase reading more than this many levels below the commanded level locks the output
	  (every channel) until the user starts again. 14 is the stock firmware's open-circuit
	  tolerance (its config byte 6 maps 0/1 to 14; this unit stores 14). A zero reading is
	  therefore only distinguishable from a valid one above level 14. NEEDS A SILICON
	  MEASUREMENT of the sense reading against the commanded level (sense offset, gain, the
	  stock firmware's calibration table) before it can be narrowed.

config OWO_STIM_BATTERY_START_MV
	int "Battery: a session only starts with the pack at or above this (mV)"
	default 7200
	help
	  Two-cell pack ([I] from the stock firmware's level curve, 6800 mV = 0 % to 8101 mV =
	  100 %). 7200 mV (3.6 V per cell) is the stock curve's 20 % knee. It must exceed
	  OWO_STIM_BATTERY_STOP_MV by at least the pack's sag under stimulation load, so that a
	  session that starts does not stop at once: that sag (internal resistance times the boost
	  converter's input current) is NOT MEASURED.

config OWO_STIM_BATTERY_STOP_MV
	int "Battery: a running session stops below this (mV)"
	default 6840
	help
	  The stock firmware powers the unit down when its battery level falls below 2 %, which its
	  curve puts at 6840 mV (3.42 V per cell): below it the manufacturer does not operate the
	  unit at all. The open firmware stops the output there (it does not power down: the
	  power-hold line is not identified). Read between pulses with the supply on, so it is the
	  loaded voltage.

config OWO_STIM_BATTERY_INTERVAL_MS
	int "Battery: read interval while pulses fire"
	default 1000
	range 10 10000
	help
	  The stock firmware reads its battery once per second (every 20000 ticks of its 20 kHz
	  stimulation timer). The pack is also read before the first pulse of every session.

config OWO_STIM_MONITOR_INTERVAL_MS
	int "Safety-supervision scheduling period"
	default 10
	range 1 100
	help
	  Maximum sleep period for the pump while output is armed. The pump owns the
	  watchdog lease and performs the dead-man check before it sleeps again, so
	  no separate monitor thread or stack exists. The worst-case dead-man
	  reaction is this period plus kernel scheduling latency and a currently
	  executing bounded pulse. This is not a substitute for the per-phase
	  feedback and overrun checks, which remain in the pulse job.

config OWO_STIM_STOP_INPUT_POLL_MS
	int "Stop input (power button): read interval while armed"
	default 100
	range 10 1000
	help
	  The stop input (stop-gpios, the suit's power button on its expander) stops the output on
	  its controller's change callback (the expander's /INT). While the output is armed the
	  input is also read this often: that bounds a lost /INT edge (an /INT asserted while a read
	  failed stays low and raises no further edge), and a read that fails (a dead expander, which
	  also holds the supply enables) stops the output. The stock firmware samples the button at
	  10 Hz.

config OWO_STIM_FAULT_LOCKOUT
	int "Faults before the whole output locks out until restart"
	default 3

endif # OWO_STIM
```

## modules/owo-stim/dts/bindings/dac/lltc,ltc2634.yaml
```yaml
# SPDX-License-Identifier: Apache-2.0
description: |
  LTC262x-family 12-bit SPI DAC (24-bit frame: 4-bit command, 4-bit address, 12-bit data).
  Channels 0..3 are the individual outputs; channel 15 writes all outputs at once.
  The protocol is implemented in Rust (modules/owo-stim/rust/crates/ltc2634).

compatible: "lltc,ltc2634"

include: [dac-controller.yaml, spi-device.yaml]

properties:
  "#io-channel-cells":
    const: 1

  reset-gpios:
    type: phandle-array
    description: |
      /CLR pin. Declare it GPIO_ACTIVE_LOW; the driver asserts it once during init to zero the
      outputs.

io-channel-cells:
  - output
```

## modules/owo-stim/dts/bindings/misc/owo,suit-output.yaml
```yaml
# SPDX-License-Identifier: Apache-2.0
description: |
  The OWO suit's electrode output stage, described only in terms of generic Zephyr devices, so a
  different board (or a different MCU family) needs nothing but a devicetree overlay that points
  at its own drivers. Everything that depends on the PCB (wiring, routing bytes, analog scaling)
  is a property here; nothing board-specific is compiled into the firmware.

  Everything points at stock Zephyr device classes: GPIO (H-bridge gates), a 32-pin GPIO
  controller for the channel switch (ti,sn74hc595 on SPI: the chain, its store clock as the SPI
  chip select), regulator (supply enables, e.g. regulator-fixed), PWM (boost), DAC (amplitude),
  ADC (feedback). The ADC driver must support asynchronous reads with a sequence callback
  (CONFIG_ADC_ASYNC), and Zephyr's timing API needs a source (a CPU cycle counter, or a Counter
  device named in /chosen/zephyr,timing-counter).

compatible: "owo,suit-output"

include: base.yaml

properties:
  bridge-gpios:
    type: phandle-array
    required: true
    description: |
      Four H-bridge gates in the order high-side A, high-side B, low-side A, low-side B, all
      GPIO_ACTIVE_HIGH. Off = both low sides on, both high sides off. Positive = high A + low B,
      negative = high B + low A.

  supplies:
    type: phandles
    required: true
    description: |
      Regulators that are enabled together to power the stimulation supply (at most four).
      regulator-fixed nodes with an enable-gpios line are enough.

  switch:
    type: phandle
    required: true
    description: |
      GPIO controller whose pins are the channel switch's control lines (ti,sn74hc595, ngpios = 32,
      verify-readback if the chain's output is wired back to the SPI controller's MISO).

  switch-routes:
    type: array
    required: true
    description: |
      One 32-bit word per electrode channel (channel 0 first): the switch pins that are on for that
      channel. The first byte shifted into the chain is bits 31..24.

  pwms:
    type: phandle-array
    required: true
    description: PWM output that drives the boost converter. The period sets the frequency.

  boost-duty-percent:
    type: int
    default: 50
    description: Duty cycle while the supply is on.

  io-channels:
    type: phandle-array
    required: true
    description: |
      The "amplitude" DAC channel (output cell) and the "sense" ADC channel (a channel child node
      of the ADC, with its resolution, gain and reference).

  io-channel-names:
    type: string-array
    required: true
    description: Must be "amplitude", "sense" in the order of io-channels.

  amplitude-resolution:
    type: int
    default: 12
    description: Resolution passed to the DAC channel setup.

  amplitude-scale:
    type: array
    required: true
    description: |
      <num den>: DAC code = level * num / den. The stock firmware uses <0x12FED 0x9C4>
      (about 31.1 codes per level on a 12 bit DAC).

  max-level:
    type: int
    default: 126
    description: Highest level the stage accepts (stock protocol range is 0..126).

  sense-uv-per-level:
    type: int
    required: true
    description: |
      Microvolts at the ADC pin per level step: level = max(microvolts / this - sense-offset, 0).
      The conversion from the raw sample to microvolts is Zephyr's (adc_raw_to_millivolts_dt: the
      channel's resolution, gain and reference). The stock firmware (12 bit, 3.3 V reference)
      corresponds to 19150.

  sense-offset:
    type: int
    default: 0
    description: Levels subtracted from the converted reading (stock firmware uses 3).
```

## modules/owo-stim/dts/bindings/misc/owo,switch-chain.yaml
```yaml
# SPDX-License-Identifier: Apache-2.0
description: |
  OWO suit channel switch: four shift-register bytes with a separate latch input. The latch is
  not a chip select (it is raised after shifting and held high while the read-back is clocked),
  so it is described in the owo,suit-output node and this SPI device has no cs-gpios.

compatible: "owo,switch-chain"

include: spi-device.yaml
```
